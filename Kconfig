## Kconfig
```kconfig
mainmenu "NirmalaSYS configuration"

menu "Version"

config VERSION_MAJOR
	int "Major version"
	range 0 255
	default 0

config VERSION_MINOR
	int "Minor version"
	range 0 255
	default 9

config VERSION_PATCH
	int "Patch level"
	range 0 255
	default 0

config VERSION_EXTRA
	string "Extra version suffix"
	default ""
	help
	  Appended to the version, for example "-rc1" or "-dev".

config VERSION_CODENAME
	string "Release codename"
	default ""

endmenu

menu "Display"

config FBCON_SCALE
	int "Framebuffer console font scale (0 = auto)"
	range 0 8
	default 0
	help
	  Integer scale of the 8x16 font. 0 picks the largest scale that
	  still leaves at least 80x25 cells on the framebuffer.

endmenu

menu "Build"

config CROSS_PREFIX
	string "Toolchain prefix"
	default ""
	help
	  Prefix for gcc, ld and ar. Leave empty to use the native toolchain
	  on an x86_64 Linux host and x86_64-elf- on any other host.

config OPT_LEVEL
	int "Optimisation level"
	range 0 3
	default 2

config DEBUG_INFO
	bool "Generate debug information"
	default y

config WERROR
	bool "Treat compiler warnings as errors"
	default y

endmenu

menu "Debugging"

config TRACE
	bool "Log process creation and exit in the kernel"
	default n

config SELFTEST
	bool "Build with selftests"
	default n
	select TRACE
	help
	  Adds the scheduler test processes, runs the userland selftest
	  from init and enables kernel process tracing.

endmenu

menu "Storage"

config NODISK
	bool "Boot with the volatile RAM disk only"
	default n
	help
	  Do not attach the persistent virtio-blk disk image.

config QEMU_SATA
	bool "Attach the QEMU disk as SATA (AHCI)"
	default n
	depends on !NODISK
	help
	  Use an AHCI disk instead of virtio-blk, matching what VirtualBox
	  and most real machines provide.

config DISK_SIZE
	string "Disk image size"
	default "64M"
	depends on !NODISK

endmenu

menu "Emulator"

config QEMU_MEM
	string "Guest memory"
	default "256M"

endmenu

menu "Boot"

config BOOT_TIMEOUT
	int "Boot menu timeout in seconds"
	range 0 60
	default 3

config LIMINE_BRANCH
	string "Limine binary branch"
	default "v11.x-binary"

endmenu
```
